VERSION ""

NS_ :

BS_:

BU_: XXX

BO_ 47 BRAKE_PRESSED: 8 XXX
 SG_ BRAKE_PRESSED : 32|2@1+ (1,0) [0|3] "" XXX
