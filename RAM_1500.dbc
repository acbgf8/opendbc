VERSION ""

NS_ :

BS_:

BU_: XXX

BO_ 179 DOOR_OPEN_FL: 8 XXX
 SG_ DOOR_OPEN_FL : 34|1@0+ (1,0) [0|1] "" XXX

BO_ 311 SEATBELT_DRIVER_UNLATCHED: 8 XXX
 SG_ SEATBELT_DRIVER_UNLATCHED : 60|5@0+ (1,0) [0|31] "" XXX
