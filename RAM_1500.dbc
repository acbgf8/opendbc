VERSION ""

NS_ :

BS_:

BU_: XXX

BO_ 179 DOOR_OPEN_FL: 8 XXX
 SG_ DOOR_OPEN_FL : 34|1@0+ (1,0) [0|1] "" XXX

BO_ 311 SEATBELT_DRIVER_UNLATCHED: 8 XXX
 SG_ SEATBELT_DRIVER_UNLATCHED : 60|5@0+ (1,0) [0|31] "" XXX

BO_ 792 TURN_SIGNALS: 8 XXX
 SG_ TURN_SIGNALS : 0|2@1+ (1,0) [0|3] "" XXX

CM_ SG_ 792 TURN_SIGNALS "RIGHT IS 2 LEFT IS 1";
